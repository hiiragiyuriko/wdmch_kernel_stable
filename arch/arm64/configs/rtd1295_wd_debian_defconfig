## drivers/clk/realtek/Kconfig
```kconfig
# SPDX-License-Identifier: GPL-2.0-only
config COMMON_CLK_REALTEK
	bool "Clock driver for Realtek RTD SoCs"
	depends on ARCH_REALTEK || COMPILE_TEST
	select RESET_CONTROLLER
	select MFD_SYSCON
	help
	  Common clock framework support for Realtek RTD129x family SoCs.

config CLK_PLL_PSAUD
	bool

config CLK_PLL_DIF
	bool

config CLK_PLL_EDP
	bool

config CLK_PLL_PIXEL
	bool

config COMMON_CLK_RTD1295
	bool "RTD1295 Clock Controller"
	depends on COMMON_CLK_REALTEK
	default ARCH_REALTEK
	help
	  Support for the CRT and ISO clock controllers on the Realtek RTD1295.
```

## drivers/phy/realtek/Kconfig
```kconfig
# SPDX-License-Identifier: GPL-2.0
#
# Phy drivers for Realtek platforms
#

if ARCH_REALTEK || COMPILE_TEST

config PHY_RTK_RTD_USB2PHY
	tristate "Realtek RTD USB2 PHY Transceiver Driver"
	depends on USB_SUPPORT
	select GENERIC_PHY
	select USB_PHY
	select USB_COMMON
	help
	  Enable this to support Realtek SoC USB2 phy transceiver.
	  The DHC (digital home center) RTD series SoCs used the Synopsys
	  DWC3 USB IP. This driver will do the PHY initialization
	  of the parameters.

config PHY_RTK_RTD_USB3PHY
	tristate "Realtek RTD USB3 PHY Transceiver Driver"
	depends on USB_SUPPORT
	select GENERIC_PHY
	select USB_PHY
	select USB_COMMON
	help
	  Enable this to support Realtek SoC USB3 phy transceiver.
	  The DHC (digital home center) RTD series SoCs used the Synopsys
	  DWC3 USB IP. This driver will do the PHY initialization
	  of the parameters.

config PHY_RTK_RTD_SATA
	tristate "Realtek RTD SATA PHY driver"
	depends on OF
	select GENERIC_PHY
	help
	  Enable this to support the SATA PHY on Realtek RTD129x SoCs
	  (e.g. the WD My Cloud Home / Monarch board). The driver loads the
	  per-board PHY parameter tables and powers the SATA PHY on for the
	  AHCI host controller.

endif # ARCH_REALTEK || COMPILE_TEST
```

## drivers/pmdomain/realtek/Kconfig
```kconfig
# SPDX-License-Identifier: GPL-2.0-only
config REALTEK_RTD1295_PD
	bool "Realtek RTD1295 power-domain controller"
	depends on (ARCH_REALTEK || COMPILE_TEST) && PM
	select PM_GENERIC_DOMAINS
	select MFD_SYSCON
	default ARCH_REALTEK
	help
	  Power-domain (genpd) controller for the Realtek RTD1295 SoC. It
	  gates the video engines, the Mali GPU and the NAT accelerator using
	  the SoC's isolation/SRAM power islands, and lets the genpd core power
	  down the blocks that have no driver attached. Say Y to save power on
	  RTD1295 boards that do not use those blocks (e.g. NAS products).
```

## drivers/soc/realtek/Kconfig
```kconfig
# SPDX-License-Identifier: GPL-2.0-only
config REALTEK_SOC_CHIP
	bool "Realtek RTD129x chip id/revision helper"
	depends on ARCH_REALTEK || COMPILE_TEST
	default ARCH_REALTEK
	help
	  Provides get_rtd_chip_id()/get_rtd_chip_revision() used by Realtek
	  RTD129x SoC drivers (e.g. the on-SoC GMAC) for revision-specific
	  register initialisation.
```
